/dts-v1/;
/plugin/;

#include "pipa-sm8250-stock-overlay.dtsi"
/ {
	model = "Qualcomm Technologies, Inc. xiaomi pipa";
	compatible = "qcom,kona-mtp", "qcom,kona", "qcom,mtp";
	qcom,board-id = <52 0>;
};
